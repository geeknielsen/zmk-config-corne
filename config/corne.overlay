#include <dt-bindings/led/led.h>

/ {
    chosen {
        zmk,underglow = &led_strip;
    };
};

&spi3 {
    status = "okay";

    led_strip: ws2812@0 {
        compatible = "worldsemi,ws2812-spi";
        reg = <0>;
        spi-max-frequency = <4000000>;

        /* 27 pr halvdel (21 per-key + 6 underglow) */
        chain-length = <27>;

        /* WS2812/SK6812 GRB rækkefølge (typisk) */
        color-mapping = <LED_COLOR_ID_GREEN LED_COLOR_ID_RED LED_COLOR_ID_BLUE>;

        /* Disse frames er standard for ws2812-spi i ZMK-eksempler */
        spi-one-frame = <0x70>;
        spi-zero-frame = <0x40>;

        status = "okay";
    };
};
